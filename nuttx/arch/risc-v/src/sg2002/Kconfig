## nuttx/arch/risc-v/src/sg2002/Kconfig
```kconfig
config SG2002_QEMU_SIM
    bool "qemu sim"
    default n

config SG2002_I2C1
    bool "i2c1 enable"
    default n

config SG2002_I2C3
    bool "i2c3 enable"
    default n
    
```
